## configs/pirouter_defconfig
```kconfig
BR2_arm=y
BR2_arm1176jzf_s=y
BR2_GLOBAL_PATCH_DIR="$(BR2_EXTERNAL_PIROUTER_PATH)/patches"
BR2_PTHREADS_NONE=y
# BR2_UCLIBC_INSTALL_UTILS is not set
BR2_ROOTFS_MERGED_USR=y
BR2_TARGET_GENERIC_HOSTNAME=""
BR2_TARGET_GENERIC_ISSUE=""
BR2_INIT_NONE=y
BR2_ROOTFS_DEVICE_TABLE="$(BR2_EXTERNAL_PIROUTER_PATH)/board/device_table.txt"
# BR2_TARGET_GENERIC_GETTY is not set
# BR2_TARGET_GENERIC_REMOUNT_ROOTFS_RW is not set
BR2_ENABLE_LOCALE_WHITELIST=""
BR2_ROOTFS_OVERLAY="$(BR2_EXTERNAL_PIROUTER_PATH)/board/overlay"
BR2_ROOTFS_POST_BUILD_SCRIPT="$(BR2_EXTERNAL_PIROUTER_PATH)/board/post-build.sh"
BR2_ROOTFS_POST_SCRIPT_ARGS="$(BR2_EXTERNAL_PIROUTER_PATH)"
BR2_LINUX_KERNEL=y
BR2_LINUX_KERNEL_CUSTOM_TARBALL=y
BR2_LINUX_KERNEL_CUSTOM_TARBALL_LOCATION="https://github.com/raspberrypi/linux/archive/rpi-4.9.y/linux-rpi-4.9.y.tar.gz"
BR2_LINUX_KERNEL_USE_CUSTOM_CONFIG=y
BR2_LINUX_KERNEL_CUSTOM_CONFIG_FILE="$(BR2_EXTERNAL_PIROUTER_PATH)/board/linux-4.9-multi.config"
BR2_LINUX_KERNEL_DTS_SUPPORT=y
BR2_LINUX_KERNEL_INTREE_DTS_NAME="bcm2708-rpi-b-plus bcm2709-rpi-2-b"
BR2_PACKAGE_BUSYBOX_CONFIG="$(BR2_EXTERNAL_PIROUTER_PATH)/board/busybox.config"
BR2_PACKAGE_LINUX_FIRMWARE=y
BR2_PACKAGE_LINUX_FIRMWARE_RTL_81XX=y
BR2_PACKAGE_RPI_FIRMWARE=y
BR2_PACKAGE_IPTABLES=y
BR2_PACKAGE_PPPD=y
BR2_PACKAGE_RADVD=y
BR2_PACKAGE_TCPDUMP=y
BR2_TARGET_ROOTFS_CPIO=y
BR2_TARGET_ROOTFS_CPIO_GZIP=y
# BR2_TARGET_ROOTFS_TAR is not set
BR2_PACKAGE_SIT_CTL=y
BR2_PACKAGE_HOSTAPD_REALTEK=y
BR2_PACKAGE_XL2TP_NO_OPENSSL=y
```

## package/hostapd-my/Config.in
```kconfig
config BR2_PACKAGE_HOSTAPD_MY
	bool "hostapd-rtl lite"
	depends on BR2_USE_MMU # fork()
	help
	  User space daemon for wireless access points.

	  It implements IEEE 802.11 access point management,
	  IEEE 802.1X/WPA/WPA2/EAP authenticators, RADIUS client,
	  EAP server and RADIUS authentication server.

	  http://hostap.epitest.fi/
```

## package/hostapd-realtek/Config.in
```kconfig
config BR2_PACKAGE_HOSTAPD_REALTEK
	bool "hostapd-realtek"
	depends on BR2_USE_MMU # fork()
	help
	  User space daemon for Realtek wireless access points.

	  It implements IEEE 802.11 access point management,
	  IEEE 802.1X/WPA/WPA2/EAP authenticators, RADIUS client,
	  EAP server and RADIUS authentication server.

	  http://w1.fi/
	  https://github.com/pritambaral/hostapd-rtl871xdrv
```

## package/sit-ctl/Config.in
```kconfig
config BR2_PACKAGE_SIT_CTL
	bool "sit-ctl"
	help
		Remotely controls sit tunnel endpoint.
```

## package/xl2tp-no-openssl/Config.in
```kconfig
config BR2_PACKAGE_XL2TP_NO_OPENSSL
	bool "xl2tp w/o OpenSSL"
	depends on BR2_USE_MMU # fork()
	select BR2_PACKAGE_LIBPCAP
	help
	  Layer 2 Tunnelling Protocol (RFC2661).

	  xl2tpd is an open source implementation of the L2TP tunneling
	  protocol. xl2tpd is forked from l2tpd and is maintained by
	  Xelerance Corporation.

	  http://www.xelerance.com/software/xl2tpd/
```
